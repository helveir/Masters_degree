#include "Display.h"

// ============================================================================
// ШРИФТЫ
// ============================================================================
// Используем встроенные шрифты из библиотеки Adafruit_GFX:
// - 6x8 (маленький): 6 пикселей ширина, 8 высота. Помещается ~21 символ в строку
// - 8x16 (средний): для заголовков
// Размер буфера для строк (максимум символов на одну строку)
#define MAX_STR_LEN 32

// ============================================================================
// КОНСТАНТЫ ДЛЯ ШКАЛЫ ДАВЛЕНИЯ
// ============================================================================
// Минимальное и максимальное давление для шкалы (в кПа)
// Ваше устройство работает в диапазоне -5..+5 кПа от атмосферного
const int MIN_PRESSURE = -5;
const int MAX_PRESSURE = 5;

// Координаты шкалы на экране:
// xStart, yStart: верхний левый угол шкалы
// width: ширина шкалы в пикселях
// height: высота шкалы
const int BAR_X = 10;      // Отступ слева 10 пикселей
const int BAR_Y = 40;      // Отступ сверху 40 пикселей (под текстом)
const int BAR_WIDTH = 108;  // Ширина шкалы (128 - 10*2 = 108)
const int BAR_HEIGHT = 12;  // Высота шкалы 12 пикселей

// ============================================================================
// BEGIN - ИНИЦИАЛИЗАЦИЯ ДИСПЛЕЯ
// ============================================================================
bool Display::begin() {
    // ------------------------------------------------------------------------
    // ПОПЫТКА ПОДКЛЮЧИТЬСЯ К ДИСПЛЕЮ
    // ------------------------------------------------------------------------
    // display.begin() инициализирует дисплей
    // SSD1306_SWITCHCAPVCC - использовать внутренний повышающий преобразователь
    // OLED_ADDR - I2C адрес дисплея (0x3C или 0x3D)
    // Функция возвращает true, если дисплей отвечает на I2C шине
    if (!_display.begin(SSD1306_SWITCHCAPVCC, OLED_ADDR)) {
        // Дисплей не найден! Сохраняем это в флаг
        _connected = false;
        
        // Включаем встроенный светодиод на пине 13 как индикатор ошибки
        pinMode(LED_BUILTIN, OUTPUT);
        digitalWrite(LED_BUILTIN, HIGH);  // Зажигаем светодиод - сигнал "нет дисплея"
        
        return false;  // Возвращаем false - ошибка подключения
    }
    
    // Дисплей успешно подключён
    _connected = true;
    
    // ------------------------------------------------------------------------
    // НАСТРОЙКА ПАРАМЕТРОВ ОТОБРАЖЕНИЯ
    // ------------------------------------------------------------------------
    // Очищаем буфер дисплея (все пиксели выключены)
    _display.clearDisplay();
    
    // Устанавливаем цвет текста (белый, так как дисплей монохромный)
    // SSD1306_WHITE - светящийся пиксель
    // SSD1306_BLACK - тёмный пиксель (можно рисовать "чёрным по белому" для инверсии)
    _display.setTextColor(SSD1306_WHITE);
    
    // Устанавливаем размер шрифта 1 (базовый шрифт 6x8 пикселей)
    // Размер 2 = 12x16, размер 3 = 18x24 и т.д.
    _display.setTextSize(1);
    
    // Устанавливаем начальную позицию курсора (0,0 - левый верхний угол)
    _display.setCursor(0, 0);
    
    // Отображаем заставку
    showSplash();
    
    return true;
}

// ============================================================================
// SHOW SPLASH - ЗАСТАВКА ПРИ ВКЛЮЧЕНИИ
// ============================================================================
void Display::showSplash() {
    if (!_connected) return;
    
    // Очищаем экран
    _display.clearDisplay();
    
    // ------------------------------------------------------------------------
    // РИСУЕМ РАМКУ
    // ------------------------------------------------------------------------
    // drawRect(x, y, ширина, высота, цвет)
    // 0,0 - верхний левый угол, поехали по периметру
    _display.drawRect(0, 0, SCREEN_WIDTH, SCREEN_HEIGHT, SSD1306_WHITE);
    
    // ------------------------------------------------------------------------
    // РИСУЕМ ЗАГОЛОВОК
    // ------------------------------------------------------------------------
    _display.setTextSize(2);           // Увеличиваем шрифт для заголовка
    _display.setCursor(8, 12);         // Позиция: x=8, y=12
    _display.println(F("Pressure"));   // Выводим строку
    
    _display.setCursor(20, 32);        // Следующая строка, с отступом
    _display.println(F("System"));
    
    // ------------------------------------------------------------------------
    // РИСУЕМ ВЕРСИЮ ПРОГРАММЫ
    // ------------------------------------------------------------------------
    _display.setTextSize(1);           // Маленький шрифт для версии
    _display.setCursor(40, 52);        // Почти внизу
    _display.println(F("v1.0"));
    
    // ------------------------------------------------------------------------
    // ОТПРАВЛЯЕМ БУФЕР НА ЭКРАН
    // ------------------------------------------------------------------------
    // Все команды рисования сначала записываются в буфер в памяти Arduino
    // display() отправляет весь буфер на дисплей по I2C
    _display.display();
    
    // Задержка для отображения заставки (здесь delay допустим, так как в setup)
    delay(2000);
}

// ============================================================================
// SHOW ERROR - СООБЩЕНИЕ ОБ ОШИБКЕ (КОГДА НЕТ ДИСПЛЕЯ)
// ============================================================================
// Этот метод вызывается, если дисплей не отвечает
// Выводит сообщение в Serial (дисплей всё равно не работает)
void Display::showError(const char* message) {
    if (_connected) {
        // Если дисплей всё же подключён, пытаемся вывести на него
        _display.clearDisplay();
        _display.setCursor(0, 0);
        _display.setTextSize(1);
        _display.println(F("ERROR:"));
        _display.println(message);
        _display.display();
    }
    
    // Дублируем в последовательный порт для отладки
    Serial.print(F("Display ERROR: "));
    Serial.println(message);
}

// ============================================================================
// UPDATE - ОСНОВНОЙ МЕТОД ОБНОВЛЕНИЯ ЭКРАНА
// ============================================================================
// Этот метод вызывается из основного цикла при изменении любых параметров
// Вся информация о системе отображается на экране
void Display::update(int pressure, int setpoint, int systemState, 
                     bool feedActive, bool suctionActive) {
    if (!_connected) return;
    
    // ------------------------------------------------------------------------
    // ОЧИЩАЕМ ЭКРАН И РИСУЕМ РАМКУ
    // ------------------------------------------------------------------------
    _display.clearDisplay();
    drawBorder();
    
    // ------------------------------------------------------------------------
    // СТРОКА 1: СОСТОЯНИЕ СИСТЕМЫ И ЗНАЧЕНИЯ ДАВЛЕНИЯ
    // ------------------------------------------------------------------------
    _display.setTextSize(1);           // Шрифт 6x8 для основной информации
    
    // Выводим состояние системы в зависимости от systemState
    // systemState: 0=ожидание, 1=работа, 2=авария
    _display.setCursor(2, 2);          // Позиция: левый верхний угол (внутри рамки)
    switch(systemState) {
        case 0:
            _display.print(F("IDLE"));   // Ожидание
            break;
        case 1:
            _display.print(F("WORK"));   // Работа
            break;
        case 2:
            _display.print(F("ALARM"));  // Авария
            break;
        default:
            _display.print(F("UNKN"));
    }
    
    // ------------------------------------------------------------------------
    // ВЫВОД ТЕКУЩЕГО ДАВЛЕНИЯ И УСТАВКИ (справа на экране)
    // ------------------------------------------------------------------------
    // setCursor(65, 2) - начинаем с позиции x=65, y=2
    _display.setCursor(65, 2);
    _display.print(F("P:"));           // Буква P - Pressure (давление)
    _display.print(pressure);          // Текущее давление в кПа
    _display.print(F("kPa"));
    
    _display.setCursor(65, 12);
    _display.print(F("S:"));           // S - Setpoint (уставка)
    _display.print(setpoint);
    _display.print(F("kPa"));
    
    // ------------------------------------------------------------------------
    // ВЫВОД ИКОНОК КЛАПАНОВ (В ПРАВОМ ВЕРХНЕМ УГЛУ)
    // ------------------------------------------------------------------------
    drawValveIcons(feedActive, suctionActive);
    
    // ------------------------------------------------------------------------
    // СТРОКА 2-3: ШКАЛА ДАВЛЕНИЯ
    // ------------------------------------------------------------------------
    drawPressureBar(pressure, setpoint, MIN_PRESSURE, MAX_PRESSURE);
    
    // ------------------------------------------------------------------------
    // СТРОКА 4: СОСТОЯНИЕ КЛАПАНОВ ТЕКСТОМ (для дублирования)
    // ------------------------------------------------------------------------
    _display.setCursor(2, SCREEN_HEIGHT - 16);  // Почти внизу экрана
    _display.print(F("F:"));   // Feed (подача)
    _display.print(feedActive ? F("ON ") : F("OFF"));
    
    _display.setCursor(50, SCREEN_HEIGHT - 16);
    _display.print(F("S:"));   // Suction (отсос)
    _display.print(suctionActive ? F("ON ") : F("OFF"));
    
    // ------------------------------------------------------------------------
    // СТРОКА 5: ИКОНКА СОСТОЯНИЯ (СЛЕВА ВНИЗУ)
    // ------------------------------------------------------------------------
    drawStateIcon(systemState);
    
    // ------------------------------------------------------------------------
    // ОТПРАВЛЯЕМ БУФЕР НА ЭКРАН
    // ------------------------------------------------------------------------
    _display.display();
}

// ============================================================================
// DRAW BORDER - РИСУЕТ РАМКУ ВОКРУГ ЭКРАНА
// ============================================================================
void Display::drawBorder() {
    // drawRect(x, y, width, height, color)
    // x=0, y=0: начинаем с левого верхнего угла
    // width=128, height=64: на всю площадь экрана
    // SSD1306_WHITE: рисуем белыми пикселями
    _display.drawRect(0, 0, SCREEN_WIDTH, SCREEN_HEIGHT, SSD1306_WHITE);
}

// ============================================================================
// DRAW PRESSURE BAR - ГРАФИЧЕСКАЯ ШКАЛА ДАВЛЕНИЯ
// ============================================================================
// Рисует горизонтальную шкалу, где:
// - Зелёная полоска показывает текущее давление
// - Маленький треугольник показывает уставку (целевое значение)
void Display::drawPressureBar(int pressure, int setpoint, int minPressure, int maxPressure) {
    // ------------------------------------------------------------------------
    // РАСЧЁТ ПОЗИЦИИ ДЛЯ ТЕКУЩЕГО ДАВЛЕНИЯ
    // ------------------------------------------------------------------------
    // Диапазон давлений: от -5 кПа до +5 кПа -> всего 10 кПа
    int pressureRange = maxPressure - minPressure;  // 5 - (-5) = 10 кПа
    
    // Смещение от минимума: current - min
    int pressureOffset = pressure - minPressure;    // Например: 2 - (-5) = 7
    
    // Вычисляем позицию в пикселях
    // Шкала имеет ширину BAR_WIDTH пикселей (108)
    // pressurePosition = (offset / range) * BAR_WIDTH
    int pressurePosition = (pressureOffset * BAR_WIDTH) / pressureRange;
    
    // Ограничиваем, чтобы не вылезло за границы шкалы
    if (pressurePosition < 0) pressurePosition = 0;
    if (pressurePosition > BAR_WIDTH) pressurePosition = BAR_WIDTH;
    
    // ------------------------------------------------------------------------
    // РАСЧЁТ ПОЗИЦИИ ДЛЯ УСТАВКИ (SETPOINT)
    // ------------------------------------------------------------------------
    int setpointOffset = setpoint - minPressure;
    int setpointPosition = (setpointOffset * BAR_WIDTH) / pressureRange;
    if (setpointPosition < 0) setpointPosition = 0;
    if (setpointPosition > BAR_WIDTH) setpointPosition = BAR_WIDTH;
    
    // ------------------------------------------------------------------------
    // РИСУЕМ ФОН ШКАЛЫ (СЕРАЯ ПОЛОСА С РАЗМЕТКОЙ)
    // ------------------------------------------------------------------------
    // Рисуем внешнюю рамку шкалы
    _display.drawRect(BAR_X, BAR_Y, BAR_WIDTH, BAR_HEIGHT, SSD1306_WHITE);
    
    // Рисуем заливку для текущего давления (зелёная полоска)
    // fillRect(x, y, width, height, color)
    // Заполняем от начала шкалы до pressurePosition
    _display.fillRect(BAR_X, BAR_Y, pressurePosition, BAR_HEIGHT, SSD1306_WHITE);
    
    // ------------------------------------------------------------------------
    // РИСУЕМ ТРЕУГОЛЬНИК-МАРКЕР ДЛЯ УСТАВКИ
    // ------------------------------------------------------------------------
    // Координата X для маркера уставки (сдвинута на BAR_X)
    int markerX = BAR_X + setpointPosition;
    int markerY = BAR_Y - 2;  // На 2 пикселя выше шкалы
    
    // Рисуем треугольник (маленькую стрелку вверх)
    // fillTriangle(x1,y1, x2,y2, x3,y3, color)
    _display.fillTriangle(markerX - 2, markerY + 1,    // Левая точка
                          markerX + 2, markerY + 1,    // Правая точка
                          markerX, markerY - 2,        // Верхняя точка
                          SSD1306_WHITE);
    
    // ------------------------------------------------------------------------
    // ПОДПИСИ К ШКАЛЕ (MIN И MAX)
    // ------------------------------------------------------------------------
    _display.setTextSize(1);
    
    _display.setCursor(BAR_X - 4, BAR_Y + 3);
    _display.print(minPressure);
    
    _display.setCursor(BAR_X + BAR_WIDTH - 8, BAR_Y + 3);
    _display.print(maxPressure);
}

// ============================================================================
// DRAW STATE ICON - РИСУЕТ ИКОНКУ СОСТОЯНИЯ СИСТЕМЫ
// ============================================================================
void Display::drawStateIcon(int state) {
    // Иконка рисуется в левом нижнем углу (x=2, y=SCREEN_HEIGHT-14)
    int iconX = 2;
    int iconY = SCREEN_HEIGHT - 14;
    
    switch(state) {
        case 0:  // IDLE - рисуем иконку "часы" или "пауза"
            // Рисуем круг (внешняя рамка)
            _display.drawCircle(iconX + 4, iconY + 4, 4, SSD1306_WHITE);
            // Рисуем стрелки часов (две линии)
            _display.drawLine(iconX + 4, iconY + 4, iconX + 4, iconY + 2, SSD1306_WHITE);
            _display.drawLine(iconX + 4, iconY + 4, iconX + 6, iconY + 6, SSD1306_WHITE);
            break;
            
        case 1:  // WORKING - рисуем иконку "шестерёнка" или "работа"
            // Простой вариант: закрашенный круг с точкой внутри
            _display.fillCircle(iconX + 4, iconY + 4, 4, SSD1306_WHITE);
            _display.fillCircle(iconX + 4, iconY + 4, 2, SSD1306_BLACK);  // Вырезаем внутренность
            break;
            
        case 2:  // ALARM - рисуем иконку "авария" (восклицательный знак)
            // Треугольник (основание внизу)
            _display.fillTriangle(iconX, iconY + 8, 
                                  iconX + 8, iconY + 8, 
                                  iconX + 4, iconY, 
                                  SSD1306_WHITE);
            // Восклицательный знак: палочка и точка
            _display.fillRect(iconX + 3, iconY + 2, 2, 4, SSD1306_BLACK);
            _display.fillRect(iconX + 3, iconY + 7, 2, 1, SSD1306_BLACK);
            break;
    }
    
    // Подпись под иконкой
    _display.setCursor(iconX + 12, iconY + 2);
    switch(state) {
        case 0: _display.print(F("IDLE")); break;
        case 1: _display.print(F("WORK")); break;
        case 2: _display.print(F("ALARM")); break;
    }
}

// ============================================================================
// DRAW VALVE ICONS - РИСУЕТ ИКОНКИ КЛАПАНОВ
// ============================================================================
void Display::drawValveIcons(bool feedActive, bool suctionActive) {
    // Иконки в правом верхнем углу (рядом с рамкой)
    int iconX = SCREEN_WIDTH - 28;
    int iconY = 2;
    
    // ------------------------------------------------------------------------
    // КЛАПАН ПОДАЧИ (FEED) - ЛЕВЫЙ В ВЕРХНЕМ РЯДУ
    // ------------------------------------------------------------------------
    // Рамка иконки (квадрат 8x8)
    _display.drawRect(iconX, iconY, 8, 8, SSD1306_WHITE);
    
    // Рисуем стрелку вправо (символ подачи)
    if (feedActive) {
        // Если клапан включён - закрашенная стрелка
        _display.fillTriangle(iconX + 1, iconY + 4,   // левая точка
                              iconX + 6, iconY + 1,   // верхняя
                              iconX + 6, iconY + 7,   // нижняя
                              SSD1306_WHITE);
    } else {
        // Если выключен - контурная стрелка
        _display.drawTriangle(iconX + 1, iconY + 4,
                              iconX + 6, iconY + 1,
                              iconX + 6, iconY + 7,
                              SSD1306_WHITE);
    }
    
    // ------------------------------------------------------------------------
    // КЛАПАН ОТСОСА (SUCTION) - ПРАВЫЙ В ВЕРХНЕМ РЯДУ
    // ------------------------------------------------------------------------
    iconX += 12;  // Сдвигаем на 12 пикселей вправо
    
    _display.drawRect(iconX, iconY, 8, 8, SSD1306_WHITE);
    
    // Рисуем стрелку влево (символ отсоса)
    if (suctionActive) {
        _display.fillTriangle(iconX + 7, iconY + 4,
                              iconX + 2, iconY + 1,
                              iconX + 2, iconY + 7,
                              SSD1306_WHITE);
    } else {
        _display.drawTriangle(iconX + 7, iconY + 4,
                              iconX + 2, iconY + 1,
                              iconX + 2, iconY + 7,
                              SSD1306_WHITE);
    }
    
    // ------------------------------------------------------------------------
    // ПОДПИСИ ПОД ИКОНКАМИ
    // ------------------------------------------------------------------------
    _display.setTextSize(0);  // Микро-шрифт (6x8, но уменьшенный)
    _display.setCursor(iconX - 12, iconY + 9);
    _display.print(F("F"));
    _display.setCursor(iconX, iconY + 9);
    _display.print(F("S"));
}

// ============================================================================
// IS CONNECTED - ПРОВЕРКА ПОДКЛЮЧЕНИЯ ДИСПЛЕЯ
// ============================================================================
bool Display::isConnected() {
    return _connected;
}